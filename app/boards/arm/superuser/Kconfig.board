## app/boards/arm/superuser/Kconfig.board
```kconfig
# Superuser R1 board configuration

# Copyright (c) 2025 The ZMK Contributors
# SPDX-License-Identifier: MIT

config BOARD_SUPERUSER_REV1
    bool "Superuser R1 Keyboard"
    depends on SOC_STM32F412CE
```

## app/boards/arm/superuser/Kconfig.defconfig
```kconfig
# Planck keyboard configuration

# Copyright (c) 2020 The ZMK Contributors
# SPDX-License-Identifier: MIT

if BOARD_SUPERUSER_REV1

config ZMK_KEYBOARD_NAME
    default "Superuser rev1"

config ZMK_KSCAN_MATRIX_POLLING
    default y

endif # BOARD_SUPERUSER_REV1
```

## app/boards/arm/superuser/superuser_rev1_defconfig
```kconfig
# SPDX-License-Identifier: MIT

CONFIG_SOC_SERIES_STM32F4X=y
CONFIG_SOC_STM32F412CX=y

CONFIG_ARM_MPU=y
CONFIG_HW_STACK_PROTECTION=y

# 96MHz system clock
CONFIG_SYS_CLOCK_HW_CYCLES_PER_SEC=96000000

CONFIG_PINCTRL=y
CONFIG_ZMK_KSCAN_MATRIX_POLLING=y

CONFIG_MAIN_STACK_SIZE=8192
# CONFIG_DEFAULT_THREAD_STACK_SIZE=8192
CONFIG_IDLE_STACK_SIZE=8192
CONFIG_ISR_STACK_SIZE=8192
CONFIG_SYSTEM_WORKQUEUE_STACK_SIZE=8192

# enable GPIO
CONFIG_GPIO=y

# clock configuration
CONFIG_CLOCK_CONTROL=y

CONFIG_ZMK_USB=y
CONFIG_ZMK_STUDIO=y
CONFIG_ZMK_STUDIO_LOCKING=n

CONFIG_CONSOLE=y
CONFIG_UART_CONSOLE=y
CONFIG_FAULT_DUMP=2
# CONFIG_ZMK_USB_LOGGING=y
# CONFIG_OPENOCD_SUPPORT=y

# CONFIG_LOG=y
# CONFIG_LOG_DEFAULT_LEVEL=4
# CONFIG_GPIO_LOG_LEVEL_DBG=y
# CONFIG_SETTINGS_LOG_LEVEL_DBG=y
# CONFIG_LOG_MODE_IMMEDIATE=y

# CONFIG_ZMK_HID_REPORT_TYPE_HKRO=y
CONFIG_ZMK_HID_REPORT_TYPE_NKRO=y

# CONFIG_USE_DT_CODE_PARTITION=y
# CONFIG_BUILD_OUTPUT_UF2=y

# CONFIG_SETTINGS=y
# CONFIG_SETTINGS_NVS=y
# CONFIG_NVS=y
# CONFIG_MPU_ALLOW_FLASH_WRITE=y
# CONFIG_FLASH=y
# CONFIG_FLASH_PAGE_LAYOUT=y
# CONFIG_FLASH_MAP=y
#
# CONFIG_BOOTLOADER_MCUBOOT=y
# CONFIG_MCUBOOT_VALIDATE_PRIMARY_SLOT=n

# Uncomment these two lines to add support for encoder to your firmware
#CONFIG_EC11=y
#CONFIG_EC11_TRIGGER_OWN_THREAD=y
```
